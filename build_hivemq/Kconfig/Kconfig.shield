## build_hivemq/Kconfig/Kconfig.shield
```kconfig
osource "c:/users/dawid/desktop/mqtt_copy/boards/shields/*/Kconfig.shield"
osource "C:/ncs/v2.5.0/nrf/boards/shields/*/Kconfig.shield"
```

## build_hivemq/Kconfig/Kconfig.shield.defconfig
```kconfig
osource "c:/users/dawid/desktop/mqtt_copy/boards/shields/*/Kconfig.defconfig"
osource "C:/ncs/v2.5.0/nrf/boards/shields/*/Kconfig.defconfig"
```
